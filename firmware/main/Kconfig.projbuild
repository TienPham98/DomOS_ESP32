## firmware/main/Kconfig.projbuild
```kconfig
menu "DomOS"

config DOMOS_WIFI_SSID
    string "Wi-Fi SSID"
    default "Dom_12"
    help
        Wi-Fi network name. Set this with idf.py menuconfig before flashing.

config DOMOS_WIFI_PASSWORD
    string "Wi-Fi password"
    default ""
    help
        WPA2 password. This value is compiled into the development firmware.

config DOMOS_WIFI_MAX_RETRY
    int "Wi-Fi reconnect attempts"
    default 10
    range 1 100

config DOMOS_MQTT_URI
    string "MQTT broker URI"
    default ""
    help
        Set from the private root .env before building.

config DOMOS_MQTT_USERNAME
    string "MQTT broker username"
    default ""
    help
        Optional MQTT username. Set from the private environment at build time.

config DOMOS_MQTT_PASSWORD
    string "MQTT broker password"
    default ""
    help
        Optional MQTT password. Set from the private environment at build time.

config DOMOS_DASHBOARD_URL
    string "DomOS Dashboard URL"
    default ""
    help
        Dashboard URL shown by the device. Set from .env.

config DOMOS_AI_HTTP_BASE
    string "AI Gateway HTTP base URL"
    default ""
    help
        HTTP base URL used for non-WebSocket Gateway requests. Set from .env.

config DOMOS_DEVICE_IP
    string "ESP32 static IPv4 address"
    default ""
    help
        Static device address. Set from the private root .env.

config DOMOS_GATEWAY_IP
    string "ESP32 IPv4 gateway"
    default ""

config DOMOS_NETMASK
    string "ESP32 IPv4 network mask"
    default ""

config DOMOS_OTA_FIRMWARE_URL
    string "HTTPS firmware URL"
    default ""
    help
        Complete HTTPS URL for the signed firmware image. OTA stays disabled when empty.

config DOMOS_AI_WS_URI
    string "AI Gateway WebSocket URI"
    default ""
    help
        WebSocket URI of the Python AI Gateway. Set from .env.

config DOMOS_AI_AUTH_TOKEN
    string "AI Gateway Bearer token"
    default ""
    help
        Optional Bearer token for authenticating the device to the AI Gateway.
        Leave empty if authentication is not configured.

config DOMOS_ESP_SR
    bool "ESP-SR microphone front-end and local Hey Dom recognition"
    default y
    depends on IDF_TARGET_ESP32S3 && SPIRAM
    help
        Enables VADNet with optional single-microphone noise suppression. MultiNet5
        English recognizes Hey Dom as a custom phrase, not a trained WakeNet
        model. Requires the model partition populated by the ESP-SR build.
        AEC is intentionally disabled: the board exposes no synchronized
        playback reference channel. Vietnamese STT and TTS remain cloud-side.

config DOMOS_WAKE_THRESHOLD
    int "Hey Dom MultiNet detection threshold (percent)"
    depends on DOMOS_ESP_SR
    range 1 99
    default 20
    help
        Matches Xiaozhi's custom MultiNet default of 0.2. Higher values reduce
        false wakes but can reject a short phrase spoken with a different accent.

config DOMOS_SR_NOISE_SUPPRESSION
    bool "Apply WebRTC noise suppression before local recognition"
    depends on DOMOS_ESP_SR
    default n
    help
        Optional AFE noise suppression. Keep disabled for the recognition-first
        profile, matching Xiaozhi: NS can suppress quiet wake-word consonants.
        Enable only after comparing recognition and false-wake rates on board.

config DOMOS_SR_LINEAR_GAIN_PERCENT
    int "MultiNet-only microphone gain (percent)"
    depends on DOMOS_ESP_SR
    range 100 1000
    default 400
    help
        Scales only the frame passed to MultiNet. The ES3C28P microphone uses
        its maximum codec gain but measured speech is quiet. The unscaled AFE
        output is retained for VAD endpointing and cloud STT fallback.

endmenu
```

## firmware/sdkconfig.defaults
```kconfig
CONFIG_IDF_TARGET="esp32s3"
CONFIG_ESPTOOLPY_FLASHMODE_QIO=y
CONFIG_ESPTOOLPY_FLASHFREQ_80M=y
CONFIG_ESPTOOLPY_FLASHSIZE_16MB=y
CONFIG_PARTITION_TABLE_CUSTOM=y
CONFIG_PARTITION_TABLE_CUSTOM_FILENAME="partitions.csv"
CONFIG_FREERTOS_HZ=1000
CONFIG_LOG_DEFAULT_LEVEL_INFO=y
CONFIG_LWIP_LOCAL_HOSTNAME="domos"
CONFIG_LV_COLOR_DEPTH_16=y
CONFIG_LV_COLOR_16_SWAP=y
CONFIG_LV_MEM_SIZE_KILOBYTES=64
CONFIG_LV_FONT_MONTSERRAT_14=y
CONFIG_LV_FONT_MONTSERRAT_16=y
CONFIG_LV_FONT_MONTSERRAT_20=y
CONFIG_LV_FONT_MONTSERRAT_24=y
CONFIG_LV_FONT_MONTSERRAT_48=y
CONFIG_MBEDTLS_CERTIFICATE_BUNDLE=y
# TLS for voice, MQTT and widget HTTPS must leave internal RAM for audio/DMA.
CONFIG_MBEDTLS_EXTERNAL_MEM_ALLOC=y
CONFIG_HTTPD_WS_SUPPORT=y
CONFIG_SPIRAM=y
CONFIG_SPIRAM_MODE_OCT=y
CONFIG_SPIRAM_SPEED_80M=y
CONFIG_SPIRAM_MALLOC_RESERVE_INTERNAL=65536
CONFIG_ESP_WS_CLIENT_ENABLE_DYNAMIC_BUFFER=y
CONFIG_SPIRAM_TRY_ALLOCATE_WIFI_LWIP=y
CONFIG_LV_USE_SJPG=y
CONFIG_DOMOS_WIFI_SSID="Dom_12"
CONFIG_DOMOS_MQTT_URI=""
CONFIG_DOMOS_MQTT_USERNAME=""
CONFIG_DOMOS_MQTT_PASSWORD=""
CONFIG_DOMOS_DASHBOARD_URL=""
CONFIG_DOMOS_AI_HTTP_BASE=""
CONFIG_DOMOS_DEVICE_IP=""
CONFIG_DOMOS_GATEWAY_IP=""
CONFIG_DOMOS_NETMASK=""
CONFIG_DOMOS_AI_WS_URI=""
CONFIG_DOMOS_ESP_SR=y
CONFIG_SR_MN_EN_MULTINET5_SINGLE_RECOGNITION_QUANT8=y
CONFIG_SR_VADN_VADNET1_MEDIUM=y
CONFIG_SR_NSN_WEBRTC=y
# ESP-SR needs the S3 speech-inference CPU/cache profile (not debug defaults).
CONFIG_ESP_DEFAULT_CPU_FREQ_MHZ_240=y
CONFIG_ESP32S3_INSTRUCTION_CACHE_32KB=y
CONFIG_ESP32S3_DATA_CACHE_LINE_64B=y
CONFIG_COMPILER_OPTIMIZATION_SIZE=y
```
